## CMakeLists.txt
```
#
# Copyright (c) 2022, The OpenThread Authors.
# All rights reserved.
# BDS-3
#

cmake_minimum_required(VERSION 3.20.0)

find_package(Zephyr REQUIRED HINTS $ENV{ZEPHYR_BASE})

project(bbtc)

# NORDIC SDK APP START
target_sources(app PRIVATE src/main.c)
# NORDIC SDK APP END
```

## Kconfig
```
#
# Copyright (c) 2020 Nordic Semiconductor ASA
#
# SPDX-License-Identifier: LicenseRef-Nordic-5-Clause
#

menu "Zephyr Kernel"
source "Kconfig.zephyr"
endmenu

module = OT_COMMAND_LINE_INTERFACE
module-str = tcat_cli_sample
source "${ZEPHYR_BASE}/subsys/logging/Kconfig.template.log_config"
```

## prj.conf
```kconfig
#
# Copyright (c) 2020 Nordic Semiconductor
#
# SPDX-License-Identifier: LicenseRef-Nordic-5-Clause
#

# Network shell
CONFIG_SHELL=y
CONFIG_OPENTHREAD_SHELL=y
CONFIG_SHELL_ARGC_MAX=26
CONFIG_SHELL_CMD_BUFF_SIZE=416

# Enable OpenThread features set
CONFIG_OPENTHREAD_NORDIC_LIBRARY_MASTER=y

CONFIG_NET_L2_OPENTHREAD=y

# Generic networking options
CONFIG_NETWORKING=y

CONFIG_MBEDTLS_SHA1_C=n
CONFIG_FPU=y

CONFIG_GPIO_SHELL=y

#
# overlay-USB.conf
#
CONFIG_SHELL_BACKEND_SERIAL_INIT_PRIORITY=51

CONFIG_UART_LINE_CTRL=y
CONFIG_SHELL_BACKEND_SERIAL_CHECK_DTR=y
CONFIG_USB_CDC_ACM_LOG_LEVEL_OFF=y

CONFIG_USB_DEVICE_STACK=y
CONFIG_USB_DEVICE_REMOTE_WAKEUP=n
CONFIG_USB_DEVICE_MANUFACTURER="Nordic Semiconductor ASA"
CONFIG_USB_DEVICE_PRODUCT="Thread CLI"
CONFIG_USB_DEVICE_VID=0x1915
CONFIG_USB_DEVICE_PID=0x0000

#
# overlay-bbtc.conf
#
CONFIG_SYSTEM_WORKQUEUE_STACK_SIZE=2144
# CONFIG_BT_RX_STACK_SIZE=2048

# Enable Ble feture set
CONFIG_BT=y
CONFIG_BT_PERIPHERAL=y
CONFIG_BT_DEVICE_NAME="Thread BLE"
CONFIG_BT_DEVICE_APPEARANCE=833

CONFIG_OPENTHREAD_BBTC=y

CONFIG_MBEDTLS_GCM_C=y
# Increase MbedTLS heap size from 900 to 2000 for both input and output. Add 2x 1100 to the default value of 10240
CONFIG_MBEDTLS_HEAP_SIZE=12440
CONFIG_MBEDTLS_KEY_EXCHANGE_PSK_ENABLED=y


#
# overlay-debug.conf
#

# Enable multithread support in gdb
# CONFIG_DEBUG=y
# CONFIG_THREAD_MONITOR=y
# CONFIG_THREAD_STACK_INFO=y
# CONFIG_TIMESLICING=n
# CONFIG_THREAD_NAME=y
# CONFIG_DEBUG_THREAD_INFO=y
# CONFIG_OPENTHREAD_SOURCES=y

# Enable asserts
# CONFIG_ASSERT=y
# CONFIG_ASSERT_NO_COND_INFO=y


#
# overlay-logging.conf
# RTT off
# CONFIG_SHELL_LOG_BACKEND on
#

CONFIG_LOG=y

# Use separate thread for logging
CONFIG_LOG_MODE_DEFERRED=y

# Increase max log level to informative
CONFIG_LOG_MAX_LEVEL=3

# Option for configuring log level in this sample
CONFIG_OT_COMMAND_LINE_INTERFACE_LOG_LEVEL_INF=y

# Enable net module logging
# CONFIG_NET_LOG=y
# Option for configuring log level in net config library
# CONFIG_NET_CONFIG_LOG_LEVEL_INF=y

# Option for configuring log level in Zephyr L2 logging
# CONFIG_OPENTHREAD_L2_DEBUG=y
# CONFIG_OPENTHREAD_L2_LOG_LEVEL_DBG=y
# CONFIG_OPENTHREAD_L2_DEBUG_DUMP_15_4=y
# CONFIG_OPENTHREAD_L2_DEBUG_DUMP_IPV6=y

# Enable Mbed TLS logging
# CONFIG_OPENTHREAD_MBEDTLS_DEBUG=y
# CONFIG_MBEDTLS_DEBUG_LEVEL=3

# Enable OpenThread logging
CONFIG_OPENTHREAD_DEBUG=y
# CONFIG_OPENTHREAD_LOG_LEVEL_DEBG=y
# Option for configuring log level in OpenThread
CONFIG_OPENTHREAD_LOG_LEVEL_INFO=y

# Enable RTT logging backend
# CONFIG_USE_SEGGER_RTT=y
# CONFIG_LOG_BACKEND_RTT=y

# Disable UART logging backend
# CONFIG_LOG_BACKEND_UART=n
CONFIG_SHELL_LOG_BACKEND=y



# Logging settings
# ----------------

# CONFIG_MBEDTLS_DEBUG_C=y
```

## boards/nrf52840dongle_nrf52840.conf
```kconfig
#
# Copyright (c) 2023 Nordic Semiconductor
#
# SPDX-License-Identifier: LicenseRef-Nordic-5-Clause
#

CONFIG_SHELL_BACKEND_SERIAL_INIT_PRIORITY=51

CONFIG_USB_CDC_ACM_LOG_LEVEL_OFF=y

CONFIG_USB_DEVICE_MANUFACTURER="Nordic Semiconductor ASA"
CONFIG_USB_DEVICE_PRODUCT="Thread CLI"
CONFIG_USB_DEVICE_VID=0x1915
CONFIG_USB_DEVICE_PID=0x0000
```

## boards/nrf52840dongle_nrf52840.overlay
```dts
/* Copyright (c) 2021 Nordic Semiconductor ASA
 *
 * SPDX-License-Identifier: LicenseRef-Nordic-5-Clause
 */

 &uart0 {
	status = "okay";
	hw-flow-control;
};

/ {
	/*
	* In some default configurations within the nRF Connect SDK,
	* e.g. on nRF52840, the chosen zephyr,entropy node is &cryptocell.
	* This devicetree overlay ensures that default is overridden wherever it
	* is set, as this application uses the RNG node for entropy exclusively.
	*/
	chosen {
			zephyr,entropy = &rng;
	};

	/*
	 * nRF52840 dongle has pin P0.19 connected to reset. By setting it
	 * in output mode with low state reset is pulled to GND, which results in
	 * device rebooting without skipping the bootloader.
	 * openthread_config node enables doing so using diag GPIO commands.
	 */
	openthread_config: openthread {
			compatible = "openthread,config";
			diag-gpios = <&gpio0 19 GPIO_ACTIVE_HIGH>;
	};
};
```

## src/main.c
```c
/*
 *  Copyright (c) 2022, The OpenThread Authors.
 *  All rights reserved.
 *
 *  Redistribution and use in source and binary forms, with or without
 *  modification, are permitted provided that the following conditions are met:
 *  1. Redistributions of source code must retain the above copyright
 *     notice, this list of conditions and the following disclaimer.
 *  2. Redistributions in binary form must reproduce the above copyright
 *     notice, this list of conditions and the following disclaimer in the
 *     documentation and/or other materials provided with the distribution.
 *  3. Neither the name of the copyright holder nor the
 *     names of its contributors may be used to endorse or promote products
 *     derived from this software without specific prior written permission.
 *
 *  THIS SOFTWARE IS PROVIDED BY THE COPYRIGHT HOLDERS AND CONTRIBUTORS "AS IS"
 *  AND ANY EXPRESS OR IMPLIED WARRANTIES, INCLUDING, BUT NOT LIMITED TO, THE
 *  IMPLIED WARRANTIES OF MERCHANTABILITY AND FITNESS FOR A PARTICULAR PURPOSE
 *  ARE DISCLAIMED. IN NO EVENT SHALL THE COPYRIGHT HOLDER OR CONTRIBUTORS BE
 *  LIABLE FOR ANY DIRECT, INDIRECT, INCIDENTAL, SPECIAL, EXEMPLARY, OR
 *  CONSEQUENTIAL DAMAGES (INCLUDING, BUT NOT LIMITED TO, PROCUREMENT OF
 *  SUBSTITUTE GOODS OR SERVICES; LOSS OF USE, DATA, OR PROFITS; OR BUSINESS
 *  INTERRUPTION) HOWEVER CAUSED AND ON ANY THEORY OF LIABILITY, WHETHER IN
 *  CONTRACT, STRICT LIABILITY, OR TORT (INCLUDING NEGLIGENCE OR OTHERWISE)
 *  ARISING IN ANY WAY OUT OF THE USE OF THIS SOFTWARE, EVEN IF ADVISED OF THE
 *  POSSIBILITY OF SUCH DAMAGE.
 */

#include <zephyr/kernel.h>
#include <zephyr/logging/log.h>

#include <zephyr/drivers/uart.h>
#include <zephyr/usb/usb_device.h>

// Zephyr OpenThread integration Library
#include <zephyr/net/openthread.h>


// OpenThread API
#include <openthread/platform/ble.h>
#include <openthread/ble_secure.h>

#include <openthread/coap.h>
#include <openthread/coap_secure.h>

// Mbed TLS
#include <mbedtls/oid.h>

#include "x509_cert_key.h"

LOG_MODULE_REGISTER(tcat_cli_sample, CONFIG_OT_COMMAND_LINE_INTERFACE_LOG_LEVEL);

struct openthread_context *myOpenThreadContext;
otInstance *myOpenThreadInstance = NULL;

otTcatVendorInfo myVendorInfo = { .mVendorName = "My Vendor", .mPskdString = "SECRET"};

// BleSecure callback functions

void HandleBleSecureClientConnect(otInstance *aInstance, bool aConnected, bool aBleConnectionOpen, void *aContext)
{
	LOG_INF("TLS Connected: %s, BLE connection open: %s", aConnected ? "YES" : " NO",
		aBleConnectionOpen ? "YES" : " NO");

	/*
	if(!aConnected && aBleConnectionOpen)
	{
		// Connect as client
		otBleSecureConnect(aInstance;
	}
	*/
	
	if (aConnected) 
	{
		char buf[20];
		size_t len;

		len = sizeof(buf) - 1;
		otBleSecureGetPeerSubjectAttributeByOid(aInstance, MBEDTLS_OID_AT_CN,
							sizeof(MBEDTLS_OID_AT_CN) - 1, buf, &len, NULL);

		buf[len] = 0;
		LOG_INF("Peer cert. Common Name:%s", buf);

		len = sizeof(buf);
		otBleSecureGetThreadAttributeFromPeerCertificate(aInstance, 3, buf, &len);
		if (len > 0) 
		{
			LOG_INF("Peer OID 1.3.6.1.4.1.44970.3: %02X%02X%02X%02X%02X (len = %d)",
				buf[0], buf[1], buf[2], buf[3], buf[4], len);
		}

		len = sizeof(buf);
		otBleSecureGetThreadAttributeFromOwnCertificate(aInstance, 3, buf, &len);
		if (len > 0) 
		{
			LOG_INF("Own OID 1.3.6.1.4.1.44970.3: %02X%02X%02X%02X%02X (len = %d)",
				buf[0], buf[1], buf[2], buf[3], buf[4], len);
		}

		LOG_INF("Command class commissioning authorized: %s", otBleSecureIsCommandClassAuthorized(aInstance, OT_TCAT_COMMAND_CLASS_COMMISSIONING) ? "YES" : " NO");
		LOG_INF("Command class extraxtion authorized: %s", otBleSecureIsCommandClassAuthorized(aInstance, OT_TCAT_COMMAND_CLASS_EXTRACTION) ? "YES" : " NO");
		LOG_INF("Command class de-commissioning authorized: %s", otBleSecureIsCommandClassAuthorized(aInstance, OT_TCAT_COMMAND_CLASS_DECOMMISSIONING) ? "YES" : " NO");
		LOG_INF("Command class application authorized: %s", otBleSecureIsCommandClassAuthorized(aInstance, OT_TCAT_COMMAND_CLASS_APPLICATION) ? "YES" : " NO");
	}
}

void HandleBleSecureReceive(otInstance *aInstance, const otMessage *aMessage, int32_t aOffset, otTcatMessageType aTcatMessageType, const char *aServiceName, void *aContext)
{
	uint16_t nLen;
	char buf[100];

	LOG_INF("TLS Data Received len:%d offset:%d", (int)otMessageGetLength(aMessage),
		(int)aOffset);

	//nLen = otMessageGetLength(aMessage) - aOffset;
	nLen = otMessageRead(aMessage, aOffset, buf + 5, sizeof(buf) - 6);
	buf[nLen + 5] = 0;

	LOG_INF("Received:%s", buf + 5);
	memcpy(buf, "RECV:", 5);
	//otBleSecureSend(aInstance, buf, strlen(buf));
	otBleSecureSendApplicationTlv(aInstance, buf, strlen(buf));
	otBleSecureFlush(aInstance);
}

int main(void)
{
	myOpenThreadContext = openthread_get_default_context();
	myOpenThreadInstance = myOpenThreadContext->instance;

#if DT_NODE_HAS_COMPAT(DT_CHOSEN(zephyr_shell_uart), zephyr_cdc_acm_uart)

	int ret;
	const struct device *dev;
	uint32_t dtr = 0U;

	ret = usb_enable(NULL);
	if (ret != 0) {
			LOG_ERR("Failed to enable USB");
			return 0;
	}

	dev = DEVICE_DT_GET(DT_CHOSEN(zephyr_shell_uart));
	if (dev == NULL) {
			LOG_ERR("Failed to find specific UART device");
			return 0;
	}

	LOG_INF("Waiting for host to be ready to communicate");

	/* Data Terminal Ready - check if host is ready to communicate */
	while (!dtr) {
			ret = uart_line_ctrl_get(dev, UART_LINE_CTRL_DTR, &dtr);
			if (ret) {
					LOG_ERR("Failed to get Data Terminal Ready line state: %d",
							ret);
					continue;
			}
			k_msleep(100);
	}

	/* Data Carrier Detect Modem - mark connection as established */
	(void)uart_line_ctrl_set(dev, UART_LINE_CTRL_DCD, 1);
	/* Data Set Ready - the NCP SoC is ready to communicate */
	(void)uart_line_ctrl_set(dev, UART_LINE_CTRL_DSR, 1);
#endif

	// TEST TEST TEST  ---->
	otCoapResource res1;
	otCoapResource res2;

	res1.mUriPath = "dali/d";
	res1.mHandler = NULL;
	res1.mNext = NULL;
	res1.mContext = NULL;
	res2.mUriPath = "dali/e";
	res2.mHandler = NULL;
	res2.mNext = NULL;
	res2.mContext = NULL;


	LOG_INF("otCoapStart(): %s", otCoapStart(myOpenThreadInstance, OT_DEFAULT_COAP_PORT) == OT_ERROR_NONE ? "OK" : "FAIL");
	otCoapSecureSetPsk(myOpenThreadInstance, "SECRET", 6, "12345678", 8);
    otCoapSecureSetSslAuthMode(myOpenThreadInstance, false);
	// <---- TEST TEST TEST

	otBleSecureSetCertificate(myOpenThreadInstance, (const uint8_t *)(OT_CLI_TCAT_X509_CERT),
				  sizeof(OT_CLI_TCAT_X509_CERT),
				  (const uint8_t *)(OT_CLI_TCAT_PRIV_KEY),
				  sizeof(OT_CLI_TCAT_PRIV_KEY));

	otBleSecureSetCaCertificateChain(myOpenThreadInstance,
					 (const uint8_t *)(OT_CLI_TCAT_TRUSTED_ROOT_CERTIFICATE),
					 sizeof(OT_CLI_TCAT_TRUSTED_ROOT_CERTIFICATE));

	otBleSecureSetSslAuthMode(myOpenThreadInstance, true);

	//otBleSecureSetPsk(myOpenThreadInstance, "SECRET", 6, "MyDevice", 8);
	otBleSecureStart(myOpenThreadInstance, HandleBleSecureClientConnect, HandleBleSecureReceive,
			 true, NULL);
	otBleSecureTcatStart(myOpenThreadInstance, &myVendorInfo, NULL);

	return 0;
}
```

## src/x509_cert_key.h
```c
/* Certificate header file */


// Inventronics
/*
#define OT_CLI_TCAT_X509_CERT \
    "-----BEGIN CERTIFICATE-----\r\n" \
    "MIIBezCCASKgAwIBAgIEAQIDBDAKBggqhkjOPQQDAjBaMQswCQYDVQQGEwJERTER\r\n" \
    "MA8GA1UEBxMIR2FyY2hpbmcxDDAKBgNVBAsTA1NUQTERMA8GA1UEChMITXlWZW5k\r\n" \
    "b3IxFzAVBgNVBAMTDm9wdG90cm9uaWMuY29tMB4XDTIzMDgwODEwNDI0OVoXDTI0\r\n" \
    "MDgwODEwNDI0OVowGjEYMBYGA1UEAxMPVW5saW1pdGVkQWNjZXNzMFkwEwYHKoZI\r\n" \
    "zj0CAQYIKoZIzj0DAQcDQgAED3i3op7pdhAk8QvpytITPSrnhsFVg6SZhbFbAmw9\r\n" \
    "fCTGOomXDYARz2h3lSHxVdZUKjsn2bDX3s0PJ4urbpZhLqMWMBQwEgYJKwYBBAGC\r\n" \
    "3yoDBAUAAQEBATAKBggqhkjOPQQDAgNHADBEAiAyCjOy0NDw00w7tNq0HK0LX2rk\r\n" \
    "bRcWg8L4mHdYS5+lRwIgRM4b1eItMNpFTSLq174ZIjtq96QSEHA/8yS1UPyo9MM=\r\n" \
    "-----END CERTIFICATE-----\r\n"

#define OT_CLI_TCAT_PRIV_KEY \
    "-----BEGIN EC PRIVATE KEY-----\r\n" \
    "MHcCAQEEIHqCO3YjGKu1469GTKwS+w+1MHCMwKPtN+yreiXbn0b5oAoGCCqGSM49\r\n" \
    "AwEHoUQDQgAED3i3op7pdhAk8QvpytITPSrnhsFVg6SZhbFbAmw9fCTGOomXDYAR\r\n" \
    "z2h3lSHxVdZUKjsn2bDX3s0PJ4urbpZhLg==\r\n" \
    "-----END EC PRIVATE KEY-----\r\n"

#define OT_CLI_TCAT_TRUSTED_ROOT_CERTIFICATE \
    "-----BEGIN CERTIFICATE-----\r\n" \
    "MIIB3TCCAYOgAwIBAgIJAIEkU9Kpk7sQMAoGCCqGSM49BAMCMFoxCzAJBgNVBAYT\r\n" \
    "AkRFMREwDwYDVQQHEwhHYXJjaGluZzEMMAoGA1UECxMDU1RBMREwDwYDVQQKEwhN\r\n" \
    "eVZlbmRvcjEXMBUGA1UEAxMOb3B0b3Ryb25pYy5jb20wHhcNMjMwMzI0MjMwODI2\r\n" \
    "WhcNMjYwMzI0MjMwODI2WjBaMQswCQYDVQQGEwJERTERMA8GA1UEBxMIR2FyY2hp\r\n" \
    "bmcxDDAKBgNVBAsTA1NUQTERMA8GA1UEChMITXlWZW5kb3IxFzAVBgNVBAMTDm9w\r\n" \
    "dG90cm9uaWMuY29tMFkwEwYHKoZIzj0CAQYIKoZIzj0DAQcDQgAEIZXjlDNlAxIV\r\n" \
    "k19EVfeQRj755MWWlZnDhaZKbMPuuP+EML9zdIwWDeCleRP5tKq5fmWp0s81lRjr\r\n" \
    "F2AwIs/TLaMyMDAwDwYDVR0TAQH/BAUwAwEB/zAdBgNVHQ4EFgQUDf0KHNxzEy7q\r\n" \
    "znA405Fx1lQsRLowCgYIKoZIzj0EAwIDSAAwRQIhAPDKNTxO8sLkns1y7ec2w2oR\r\n" \
    "CYoQyDj2d498XeWYkSVuAiBz+GSRnTmdCFzQKfL8/ma7QaNdXihKYrWUdqvlynVV\r\n" \
    "MQ==\r\n" \
    "-----END CERTIFICATE-----\r\n"
*/

// Thread Reference
#define OT_CLI_TCAT_X509_CERT \
    "-----BEGIN CERTIFICATE-----\r\n" \
    "MIIBmDCCAT+gAwIBAgIEAQIDBDAKBggqhkjOPQQDAjBvMQswCQYDVQQGEwJYWDEQ\r\n" \
    "MA4GA1UECBMHTXlTdGF0ZTEPMA0GA1UEBxMGTXlDaXR5MQ8wDQYDVQQLEwZNeVVu\r\n" \
    "aXQxETAPBgNVBAoTCE15VmVuZG9yMRkwFwYDVQQDExB3d3cubXl2ZW5kb3IuY29t\r\n" \
    "MB4XDTIzMTAxNjEwMzk1NFoXDTI0MTAxNjEwMzk1NFowIjEgMB4GA1UEAxMXbXl2\r\n" \
    "ZW5kb3IuY29tL3RjYXQvbXlkZXYwWTATBgcqhkjOPQIBBggqhkjOPQMBBwNCAAQB\r\n" \
    "aWwFDNj1bpQIdN+Kp2cHWw55U/+fa+OmZnoy1B4BOT+822jdwPBuyXWAQoBdYdQJ\r\n" \
    "ff4RgmhczyV4PhArPIuAoxYwFDASBgkrBgEEAYLfKgMEBQABAQEBMAoGCCqGSM49\r\n" \
    "BAMCA0cAMEQCIBEHxiEDij26y6V77Q311Gj4CZAuZuPGXZpnzL2BLk7bAiAlFk6G\r\n" \
    "mYGzkcrYyssFI9HlPgrisWoMmgummaTtCuvrEw==\r\n" \
    "-----END CERTIFICATE-----\r\n"

#define OT_CLI_TCAT_PRIV_KEY \
    "-----BEGIN EC PRIVATE KEY-----\r\n" \
    "MHcCAQEEIDeJ6lVQKiOIBxKwTZp6TkU5QVHt9pvXOR9CGpPBI3DhoAoGCCqGSM49\r\n" \
    "AwEHoUQDQgAEAWlsBQzY9W6UCHTfiqdnB1sOeVP/n2vjpmZ6MtQeATk/vNto3cDw\r\n" \
    "bsl1gEKAXWHUCX3+EYJoXM8leD4QKzyLgA==\r\n" \
    "-----END EC PRIVATE KEY-----\r\n"

#define OT_CLI_TCAT_TRUSTED_ROOT_CERTIFICATE \
    "-----BEGIN CERTIFICATE-----\r\n" \
    "MIICCDCCAa2gAwIBAgIJAIKxygBXoH+5MAoGCCqGSM49BAMCMG8xCzAJBgNVBAYT\r\n" \
    "AlhYMRAwDgYDVQQIEwdNeVN0YXRlMQ8wDQYDVQQHEwZNeUNpdHkxDzANBgNVBAsT\r\n" \
    "Bk15VW5pdDERMA8GA1UEChMITXlWZW5kb3IxGTAXBgNVBAMTEHd3dy5teXZlbmRv\r\n" \
    "ci5jb20wHhcNMjMxMDE2MTAzMzE1WhcNMjYxMDE2MTAzMzE1WjBvMQswCQYDVQQG\r\n" \
    "EwJYWDEQMA4GA1UECBMHTXlTdGF0ZTEPMA0GA1UEBxMGTXlDaXR5MQ8wDQYDVQQL\r\n" \
    "EwZNeVVuaXQxETAPBgNVBAoTCE15VmVuZG9yMRkwFwYDVQQDExB3d3cubXl2ZW5k\r\n" \
    "b3IuY29tMFkwEwYHKoZIzj0CAQYIKoZIzj0DAQcDQgAEWdyzPAXGKeZY94OhHAWX\r\n" \
    "HzJfQIjGSyaOzlgL9OEFw2SoUDncLKPGwfPAUSfuMyEkzszNDM0HHkBsDLqu4n25\r\n" \
    "/6MyMDAwDwYDVR0TAQH/BAUwAwEB/zAdBgNVHQ4EFgQU4EynoSw9eDKZEVPkums2\r\n" \
    "IWLAJCowCgYIKoZIzj0EAwIDSQAwRgIhAMYGGL9xShyE6P9wEU+MAYF6W3CzdrwV\r\n" \
    "kuerX1encIH2AiEA5rq490NUobM1Au43roxJq1T6Z43LscPVbGZfULD1Jq0=\r\n" \
    "-----END CERTIFICATE-----\r\n"
```
